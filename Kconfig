## Kconfig
```kconfig
###############################################################################
# SPDX-License-Identifier: GPL-3.0-or-later
###############################################################################


mainmenu "App Configuration"

  menu "app configuration"
    source "app/Kconfig"
  endmenu

  menu "compiler configuration"
    source "scripts/menu/compiler/ChoiceCDebugLevel"
    source "scripts/menu/compiler/ChoiceCLanguageStandard"
    source "scripts/menu/compiler/ChoiceCOptimizationLevel"
    source "scripts/menu/compiler/FlagCDataSections"
    source "scripts/menu/compiler/FlagCFunctionSections"
    source "scripts/menu/compiler/FlagCStackUsage"
    source "scripts/menu/compiler/FlagCWarnAll"
    source "scripts/menu/compiler/FlagCWarnError"
    source "scripts/menu/compiler/FlagCWarnExtra"
    source "scripts/menu/compiler/FlagCWarnNoUnusedParameter"
    source "scripts/menu/compiler/FlagCWarnSwitchDefault"
    source "scripts/menu/compiler/FlagCWarnSwitchEnum"
    source "scripts/menu/compiler/FlagUsePrintfFloat"
    source "scripts/menu/compiler/FlagUseScanfFloat"
  endmenu

  menu "src configuration"
    source "src/Kconfig"
  endmenu

##################################################################################
```

## app/Kconfig
```kconfig
###############################################################################
# SPDX-License-Identifier: GPL-3.0-or-later
###############################################################################

config PRINT_INTER
  int "print log delay (Milliseconds)"
  default 1000
  range 0 10000
```

## src/Kconfig
```kconfig
###############################################################################
# SPDX-License-Identifier: GPL-3.0-or-later
###############################################################################

config TRACE_ENABLE
    bool "TRACE_ENABLE"
    default n
    help
        Enable log in app
```
